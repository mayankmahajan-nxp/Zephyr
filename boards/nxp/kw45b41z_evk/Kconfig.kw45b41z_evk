## boards/nxp/kw45b41z_evk/Kconfig.kw45b41z_evk
```kconfig
# Copyright 2023 NXP
# SPDX-License-Identifier: Apache-2.0

config BOARD_KW45B41Z_EVK
	select SOC_MKW45
	select SOC_PART_NUMBER_KW45B41Z83AFTA
```

## drivers/sensor/fxls8971cf/Kconfig
```kconfig
# FXLS8971CF 3-axis accelerometer

# Copyright 2023 NXP
# SPDX-License-Identifier: Apache-2.0

menuconfig FXLS8971CF
	bool "FXLS8971CF MAG Module"
	help
		Enable the driver for FXLS8971CF accelerometer.

if FXLS8971CF

module = FXLS8971CF
module-str = fxls8971cf
source "subsys/logging/Kconfig.template.log_config"

config FXLS8971CF_INIT_PRIORITY
	int "Counter init priority"
	default 80
	help
		FXLS8971CF driver device initialization priority.

endif # FXLS8971CF
```

## drivers/sensor/ist8310/Kconfig
```kconfig
# IST8310 MAG module configuration options

# Copyright 2023 NXP
# SPDX-License-Identifier: Apache-2.0

menuconfig IST8310
	bool "IST8310 MAG Module"
	help
		Enable the driver for IST8310 MAG Module.

if IST8310

module = IST8310
module-str = ist8310
source "subsys/logging/Kconfig.template.log_config"

config IST8310_INIT_PRIORITY
	int "Counter init priority"
	default 80
	help
		IST8310 driver device initialization priority.

endif # IST8310
```

## drivers/sensor/vl53l4cd/Kconfig
```kconfig
# VL53L4CD time of flight sensor configuration options

# Copyright 2024 NXP
# SPDX-License-Identifier: Apache-2.0

menuconfig VL53L4CD
	bool "VL53L4CD time of flight sensor"
	default y
	depends on DT_HAS_ST_VL53L4CD_ENABLED
	select I2C
	help
	  Enable driver for VL53L4CD I2C-based time of flight sensor.

if VL53L4CD

config VL53L4CD_INTERRUPT_MODE
	bool "Use interrupt mode for VL53L4CD time of flight sensor"
	default y
	depends on GPIO
	help
	  Enable interrupt mode for VL53L4CD time of flight sensor.
	  Otherwise, the driver will use the polling method.

config VL53L4CD_XSHUT
	bool "Use xshut pin on VL53L4CD time of flight sensor"
	default n
	depends on GPIO
	help
	  Enable to use the xshut pin on the VL53L4CD.
	  If not, the pin should be connected to VDD.

endif # VL53L4CD

config VL53L4CD_PROXIMITY_THRESHOLD
	int "Proximity threshold in millimeters"
	default 100
	depends on VL53L4CD
	help
	  Threshold used for proximity detection when sensor is used with SENSOR_CHAN_PROX.

config VL53L4CD_RECONFIGURE_ADDRESS
	bool "Support reconfigurable sensor address"
	depends on VL53L4CD
	depends on VL53L4CD_XSHUT
	help
	  Enable support for reconfiguring the sensor address at runtime.
	  When this option is enabled, all sensors declared on the same i2c bus in the device tree
	  must have an xshut-gpio property.

	  All sensors are disabled during initialization. When read the first value from a sensor
	  (by calling sample_fetch API), it is powered up and its I2C address is reconfigured from
	  the manufacturer default '0x29' to the address specified in the device tree.
```

## dts/bindings/gnss/u-blox,m10.yaml
```yaml
# Copyright 2024 NXP
# SPDX-License-Identifier: Apache-2.0

description: U-BLOX M10 GNSS Module

compatible: "u-blox,m10"

include:
  - uart-device.yaml
```

## dts/bindings/mag/ist8310.yaml
```yaml
# Copyright 2023 NXP
# SPDX-License-Identifier: Apache-2.0

description: IST8310 MAG Module

compatible: "ist8310"

include: i2c-device.yaml
```

## dts/bindings/sensor/invensense,icm42686.yaml
```yaml
# Copyright (c) 2024 Intel Corporation
# Copyright (c) 2022 Esco Medical ApS
# Copyright (c) 2020 TDK Invensense
# SPDX-License-Identifier: Apache-2.0

description: |
    ICM-42686 motion tracking device
    When setting the accel-pwr-mode, accel-fs, accel-odr, gyro-pwr-mode,
    gyro-fs, gyro-odr properties in a .dts or .dtsi file you may include
    icm42686.h and use the macros defined there.

    Example:
    #include <zephyr/dt-bindings/sensor/icm42686.h>

    icm42686: icm42686@0 {
      ...

      accel-pwr-mode = <ICM42686_DT_ACCEL_LN>;
      accel-fs = <ICM42686_DT_ACCEL_FS_32G>;
      accel-odr = <ICM42686_DT_ACCEL_ODR_2000>;
      gyro-pwr-mode= <ICM42686_DT_GYRO_LN>;
      gyro-fs = <ICM42686_DT_GYRO_FS_4000>;
      gyro-odr = <ICM42686_DT_GYRO_ODR_2000>;
    };
compatible: "invensense,icm42686"
include: invensense,icm4268x-common.yaml

properties:
  accel-fs:
    type: int
    default: 0
    description: |
      Specify the accelerometer range in g.
      Default is power-up configuration.
    enum:
      - 0 # ICM42686_DT_ACCEL_FS_32G
      - 1 # ICM42686_DT_ACCEL_FS_16G
      - 2 # ICM42686_DT_ACCEL_FS_8G
      - 3 # ICM42686_DT_ACCEL_FS_4G
      - 4 # ICM42686_DT_ACCEL_FS_2G

  gyro-fs:
    type: int
    default: 0
    description: |
      Specify the gyro range in degrees per second.
      Default is power-up configuration.
    enum:
      - 0 # ICM42686_DT_GYRO_FS_4000
      - 1 # ICM42686_DT_GYRO_FS_2000
      - 2 # ICM42686_DT_GYRO_FS_1000
      - 3 # ICM42686_DT_GYRO_FS_500
      - 4 # ICM42686_DT_GYRO_FS_250
      - 5 # ICM42686_DT_GYRO_FS_125
      - 6 # ICM42686_DT_GYRO_FS_62_5
      - 7 # ICM42686_DT_GYRO_FS_31_25
      - 8 # ICM42686_DT_GYRO_FS_15_625
```

## dts/bindings/sensor/nxp,fxls8971cf-common.yaml
```yaml
# Copyright 2023 NXP
# SPDX-License-Identifier: Apache-2.0

description: FXLS8971CF 3-axis accelerometer sensor

include: sensor-device.yaml
```

## dts/bindings/sensor/nxp,fxls8971cf-i2c.yaml
```yaml
# Copyright 2023 NXP
# SPDX-License-Identifier: Apache-2.0

description: FXLS8971CF 3-axis accelerometer sensor

compatible: "nxp,fxls8971cf"

include: ["i2c-device.yaml", "nxp,fxls8971cf-common.yaml"]
```

## dts/bindings/sensor/nxp,fxls8971cf-spi.yaml
```yaml
# Copyright 2023 NXP
# SPDX-License-Identifier: Apache-2.0

description: FXLS8971CF 3-axis accelerometer sensor

compatible: "nxp,fxls8971cf"

include: ["spi-device.yaml", "nxp,fxls8971cf-common.yaml"]
```

## dts/bindings/sensor/st,vl53l4cd.yaml
```yaml
# Copyright 2024 NXP
# SPDX-License-Identifier: Apache-2.0

description: STMicroelectronics VL53L4CD Time of Flight sensor

compatible: "st,vl53l4cd"

include: [sensor-device.yaml, i2c-device.yaml]

properties:
  xshut-gpios:
    type: phandle-array
    description: |
      Driving the XSHUT pin low puts the VL53L4CD into hardware
      standby (if VDD is present) or complete power off (if
      VDD is not present). Additionally, if XSHUT is connected
      directly to VDD, the sensor will go into boot mode on a
      transition from LOW to HIGH.

  int-gpios:
    type: phandle-array
    description: |
      An interrupt is raised when a data measurement is ready.
        GPIO1 is the interrupt pin on the VL53L4CD (ACTIVE LOW).
      This can be disabled if the user prefers to use polling instead.
```

## soc/nxp/kinetis/kw45/Kconfig.soc
```kconfig
# KW45 Series

# Copyright 2023 NXP
# SPDX-License-Identifier: Apache-2.0

config SOC_SERIES_KINETIS_KW45
	bool
	select SOC_FAMILY_KINETIS

config SOC_SERIES
	default "kw45" if SOC_SERIES_KINETIS_KW45

config SOC_MKW45
	bool "SOC_MKW45"
	select SOC_SERIES_KINETIS_KW45
	select ARM_TRUSTZONE_M
	select CPU_CORTEX_M_HAS_SYSTICK
	select CPU_HAS_FPU
	select CPU_HAS_ARM_SAU
	select CPU_HAS_ARM_MPU

config SOC
	default "mkw45"

config SYS_CLOCK_HW_CYCLES_PER_SEC
	default 96000000 if CORTEX_M_SYSTICK

config SOC_PART_NUMBER_KW45B41Z83AFTA
	bool

config SOC_PART_NUMBER_KINETIS_KW45
	string
	default "KW45B41Z83AFTA" if SOC_PART_NUMBER_KW45B41Z83AFTA
	help
	    This string holds the full part number of the SOC.
	    It is a hidden option that you should not set directly.
	    The part number selection choice defines the
	    default value for this string.
```
