## boards/nxp/mr_kw45/Kconfig.defconfig
```kconfig
# MR-KW45 board

# Copyright 2024 NXP
# SPDX-License-Identifier: Apache-2.0

if BOARD_MR_KW45

config BT_DIS_MANUF
	default "NXP"

endif # BOARD_MR_KW45
```

## boards/nxp/mr_kw45/Kconfig.mr_kw45
```kconfig
# Copyright 2024 NXP
# SPDX-License-Identifier: Apache-2.0

config BOARD_MR_KW45
	select SOC_KW45B41Z83
	select SOC_PART_NUMBER_KW45B41Z83AFTA
```

## boards/nxp/mr_kw45/board.yml
```yaml
board:
  name: mr_kw45
  full_name: MR-KW45
  vendor: nxp
  socs:
    - name: kw45b41z83
```

## soc/nxp/Wireless/kw/kw45x/Kconfig.soc
```kconfig
# Copyright 2025 NXP
#
# SPDX-License-Identifier: Apache-2.0

config SOC_SERIES_KW45X
	bool
	select SOC_FAMILY_KW

config SOC_SERIES
	default "kw45x" if SOC_SERIES_KW45X

config SOC_KW45B41Z83
	bool
	select SOC_SERIES_KW45X

config SOC
	default "kw45b41z83" if SOC_KW45B41Z83

config SOC_PART_NUMBER_KW45B41Z83AFTB
	bool

config SOC_PART_NUMBER
	default "KW45B41Z83AFTB" if SOC_PART_NUMBER_KW45B41Z83AFTB
```

## soc/nxp/wireless/kw/Kconfig.soc
```kconfig
# Copyright 2024-2025 NXP
# SPDX-License-Identifier: Apache-2.0

rsource "*/Kconfig.soc"

config SOC_FAMILY_KW
	bool

config SOC_FAMILY
	default "kw" if SOC_FAMILY_KW
```
