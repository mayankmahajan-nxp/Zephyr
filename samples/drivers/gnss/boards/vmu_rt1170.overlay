/*
 * Copyright 2024 NXP
 *
 * SPDX-License-Identifier: Apache-2.0
 */

/ {
	aliases {
		gnss = &lpuart3;
	};
};

&lpuart3 {
	status = "okay";
	current-speed = <9600>;

	u_blox_m10: u-blox,m10 {
		status = "okay";
		compatible = "u-blox,m10";
	};
};
